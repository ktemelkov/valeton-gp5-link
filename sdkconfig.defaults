## sdkconfig.defaults
```kconfig
CONFIG_BT_ENABLED=y
CONFIG_BT_NIMBLE_ENABLED=n
CONFIG_BT_BLUEDROID_ENABLED=n

#
# MODEM SLEEP Options
#
CONFIG_BT_CTRL_MODEM_SLEEP=y
CONFIG_BT_CTRL_MODEM_SLEEP_MODE_1=y
CONFIG_BT_CTRL_LPCLK_SEL_MAIN_XTAL=y
CONFIG_BT_CTRL_MAIN_XTAL_PU_DURING_LIGHT_SLEEP=y
# end of MODEM SLEEP Options

# Enable power down of MAC and baseband in light sleep mode [1]
CONFIG_ESP_PHY_MAC_BB_PD=n

CONFIG_ESP_PHY_ENABLE_USB=n

CONFIG_BTDM_CTRL_MODE_BLE_ONLY=y
CONFIG_BTDM_CTRL_MODE_BR_EDR_ONLY=n
CONFIG_BTDM_CTRL_MODE_BTDM=n

CONFIG_FREERTOS_HZ=1000
CONFIG_FREERTOS_USE_TICKLESS_IDLE=y
CONFIG_FREERTOS_IDLE_TIME_BEFORE_SLEEP=3

CONFIG_MBEDTLS_KEY_EXCHANGE_PSK=y
CONFIG_ESPTOOLPY_FLASHSIZE_2MB=y

# CONFIG_PM_ENABLE=y
# CONFIG_PM_DFS_INIT_AUTO=y
# CONFIG_PM_RTOS_IDLE_OPT=y
# CONFIG_PM_SLP_DISABLE_GPIO=n

CONFIG_ESP_DEFAULT_CPU_FREQ_MHZ_40=y

GPIO_ESP32_SUPPORT_SWITCH_SLP_PULL=y

# [1]
CONFIG_ESP_WIFI_ENABLED=n
CONFIG_ADC_DISABLE_DAC=y
CONFIG_ADC_DISABLE_ADC1=y
CONFIG_ADC_DISABLE_ADC2=y
CONFIG_SOC_TOUCH_SENSOR_NUM=0
CONFIG_ESP_JTAG_MUX=n
CONFIG_ESP_JTAG_SOFT_BREAKPOINTS=n
CONFIG_BOOTLOADER_WDT_ENABLE=n
```
